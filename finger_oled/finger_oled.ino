

#include <Adafruit_GFX.h>  // Include core graphics library for the display
#include <Adafruit_SSD1306.h>  // Include Adafruit_SSD1306 library to drive the display
#include <SPI.h>
#include <Wire.h>
Adafruit_SSD1306 display;  // Create display
#include <Adafruit_Fingerprint.h>
#include <SoftwareSerial.h>
#include <Fonts/FreeMonoBold12pt7b.h>  // Add a custom font
#include <Fonts/FreeMono9pt7b.h>  // Add a custom font


static const uint8_t icon [] PROGMEM = {
0x0,0x0,0x0,0x0,0x0,0x0,0x0,0x0,
0x0,0x0,0x0,0x0,0x0,0x0,0x0,0x0,
0x0,0x0,0x0,0x0,0x0,0x0,0x0,0x0,
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0x0,0x0,0x0,0x0,0x0,0x0,0x0,0x0
};

SoftwareSerial mySerial(10, 11);
Adafruit_Fingerprint finger = Adafruit_Fingerprint(&mySerial);
int fingerprintID = 0;


void setup()  // Start of setup
{                
   
  delay(100);  // This delay is needed to let the display to initialize
  display.begin(SSD1306_SWITCHCAPVCC, 0x3C);  // Initialize display with the I2C address of 0x3C
  display.clearDisplay();  // Clear the buffer
  display.setTextColor(WHITE);  // Set color of the text
  display.setRotation(0);  // Set orientation. Goes from 0, 1, 2 or 3
  display.setTextWrap(false);  // By default, long lines of text are set to automatically “wrap” back to the leftmost column.
                               // To override this behavior (so text will run off the right side of the display - useful for
                               // scrolling marquee effects), use setTextWrap(false). The normal wrapping behavior is restored
                               // with setTextWrap(true).

  display.dim(0);  //Set brightness (0 is maximun and 1 is a little dim)

   startFingerprintSensor();
     displayLockScreen(); 

}  // End of setup






void loop()  // Start of loop
{



fingerprintID = getFingerprintID();
  delay(50);
  if(fingerprintID == 1)
  {
   
    displayCamacho();
    delay(5000);
    displayLockScreen();
  }

   if(fingerprintID == 0)
  {
    
    displayArango();
    delay(5000);
    displayLockScreen();
  }
  

}  




void displayArango()
{
   display.clearDisplay();  // Clear the display so we can refresh
  display.setFont(&FreeMono9pt7b);  // Set a custom font
  display.setTextSize(0); 
  display.setCursor(10, 10);  // (x,y)
  display.println("UNLOCK");  // Text or value to print
  display.setCursor(10, 30);  // (x,y)
  display.println("WELCOME!");  // Text or value to print
  display.setCursor(10, 50);  // (x,y)
  display.println("ARANGO");  // Text or value to print
   display.display();  // Print everything we set previously
}

void displayCamacho()
{
  display.clearDisplay();  // Clear the display so we can refresh
  display.setFont(&FreeMono9pt7b);  // Set a custom font
  display.setTextSize(0); 
  display.setCursor(10, 10);  // (x,y)
  display.println("UNLOCK");  // Text or value to print
  display.setCursor(10, 30);  // (x,y)
  display.println("WELCOME!");  // Text or value to print
  display.setCursor(10, 50);  // (x,y)
  display.println("CAMACHO");  // Text or value to print
   display.display();  // Print everything we set previously
}

void displayLockScreen()
{
  display.clearDisplay();  // Clear the display so we can refresh
  display.setFont(&FreeMono9pt7b);  // Set a custom font
  display.setTextSize(0); 
  display.setCursor(70, 30);  // (x,y)
  display.println("LOCK");  // Text or value to print
  display.drawBitmap(0,0,icon,60,60,WHITE);
  display.display();  // Print everything we set previously
}
void startFingerprintSensor()
{
  Serial.begin(9600);
  finger.begin(57600);
  
  if (finger.verifyPassword()) {
    Serial.println("Found fingerprint sensor!");
  } else {
    Serial.println("Did not find fingerprint sensor");
  }
  Serial.println("Waiting for valid finger...");
}

int getFingerprintID() {
  uint8_t p = finger.getImage();
  if (p != FINGERPRINT_OK)  return -1;

  p = finger.image2Tz();
  if (p != FINGERPRINT_OK)  return -1;

  p = finger.fingerFastSearch();
  if (p != FINGERPRINT_OK)  return -1;
  
  // found a match!
  Serial.print("Found ID #"); Serial.print(finger.fingerID); 
  Serial.print(" with confidence of "); Serial.println(finger.confidence);
  return finger.fingerID; 
}

